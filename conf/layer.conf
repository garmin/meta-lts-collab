## conf/layer.conf
```bitbake
# We have a conf and classes directory, add to BBPATH
BBPATH .= ":${LAYERDIR}"

# We have recipes-* directories, add to BBFILES
BBFILES += "${LAYERDIR}/recipes-*/*/*.bb \
            ${LAYERDIR}/recipes-*/*/*.bbappend"

BBFILE_COLLECTIONS += "meta-lts-collab"
BBFILE_PATTERN_meta-lts-collab = "^${LAYERDIR}/"
BBFILE_PRIORITY_meta-lts-collab = "6"

LAYERDEPENDS_meta-lts-collab = "core"
LAYERSERIES_COMPAT_meta-lts-collab = "kirkstone"

BBFILES_DYNAMIC += " \
    core:${LAYERDIR}/meta-core/*/*/*.bbappend \
    core:${LAYERDIR}/meta-core/*/*/*.bb \
    filesystems-layer:${LAYERDIR}/meta-filesystems/*/*/*.bbappend \
    filesystems-layer:${LAYERDIR}/meta-filesystems/*/*/*.bb \
    gnome-layer:${LAYERDIR}/meta-gnome/*/*/*.bbappend \
    gnome-layer:${LAYERDIR}/meta-gnome/*/*/*.bb \
    meta-initramfs:${LAYERDIR}/meta-initramfs/*/*/*.bbappend \
    meta-initramfs:${LAYERDIR}/meta-initramfs/*/*/*.bb \
    meta-python:${LAYERDIR}/meta-python/*/*/*.bbappend \
    meta-python:${LAYERDIR}/meta-python/*/*/*.bb \
    multimedia-layer:${LAYERDIR}/meta-multimedia/*/*/*.bbappend \
    multimedia-layer:${LAYERDIR}/meta-multimedia/*/*/*.bb \
    networking-layer:${LAYERDIR}/meta-networking/*/*/*.bbappend \
    networking-layer:${LAYERDIR}/meta-networking/*/*/*.bb \
    openembedded-layer:${LAYERDIR}/meta-oe/*/*/*.bbappend \
    openembedded-layer:${LAYERDIR}/meta-oe/*/*/*.bb \
    perl-layer:${LAYERDIR}/meta-perl/*/*/*.bbappend \
    perl-layer:${LAYERDIR}/meta-perl/*/*/*.bb \
    webserver:${LAYERDIR}/meta-webserver/*/*/*.bbappend \
    webserver:${LAYERDIR}/meta-webserver/*/*/*.bb \
    xfce-layer:${LAYERDIR}/meta-xfce/*/*/*.bbappend \
    xfce-layer:${LAYERDIR}/meta-xfce/*/*/*.bb \
    "
```
